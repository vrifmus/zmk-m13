## config/west.yml
```yaml
manifest:
  remotes:
    - name: zmkfirmware
      url-base: https://github.com/zmkfirmware
    - name: badjeff
      url-base: https://github.com/badjeff
    - name: vrifmus
      url-base: https://github.com/vrifmus
  projects:
    - name: zmk
      remote: zmkfirmware
      revision: 4dd95d7
      import: app/west.yml
    - name: kb_zmk_ps2_mouse_trackpoint_driver
      remote: vrifmus
      revision: 55b1ed5
    - name: zmk-status_led
      remote: vrifmus
      revision: ea84be6
    - name: zmk-trackpoint
      remote: vrifmus
      revision: 7767a61
  self:
    path: config
```
