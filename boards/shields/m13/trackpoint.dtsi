// M13 trackpoint wiring.
// The devicetree nodes themselves live in the zmk-trackpoint module.

#define MOUSE_PS2_DRIVER_UART


#define MOUSE_PS2_PIN_SCL_PRO_MICRO <&pro_micro 1 GPIO_ACTIVE_HIGH>
#define MOUSE_PS2_PIN_SDA_PRO_MICRO <&pro_micro 0 GPIO_ACTIVE_HIGH>
#define MOUSE_PS2_PIN_SDA_PINCTRL <NRF_PSEL(UART_RX, 0, 8)>

// #define MOUSE_PS2_PIN_RST_PRO_MICRO <&pro_micro 14 GPIO_ACTIVE_HIGH>

#define MOUSE_PS2_UART_BAUD_RATE <14400>

#define MOUSE_PS2_PIN_UNEXPOSED_TX <NRF_PSEL(UART_TX, 0, 27)>
#define MOUSE_PS2_PIN_UNEXPOSED_RX <NRF_PSEL(UART_RX, 0, 28)>

// Layer in config/m13.keymap that turns the stick into a scroll wheel
// (mouse_scroll_layer, index 9).
#define TRACKPOINT_SCROLL_LAYER 9


#include <trackpoint/ps2.dtsi>
